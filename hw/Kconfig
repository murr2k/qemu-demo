## hw/Kconfig
```kconfig
# RP2040 peripheral configuration

config RP2040_UART
    bool

config RP2040_GPIO
    bool

config RP2040_TIMER
    bool
```

## hw/arm/Kconfig
```kconfig
config RP2040
    bool
    select ARM_V7M
    select RP2040_UART
    select RP2040_GPIO  
    select RP2040_TIMER
    select UNIMP

config RASPBERRYPI_PICO
    bool
    default y
    depends on TCG && ARM
    select RP2040
```
